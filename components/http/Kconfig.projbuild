## components/http/Kconfig.projbuild
```kconfig
menu "Weather-Compass Configuration"
    config EXAMPLE_HTTP_ENDPOINT
        string "Weather-Compass Endpoint"
        default "demo.thingsboard.io"
        help
            Target endpoint host-name for the example to use.
endmenu
```
